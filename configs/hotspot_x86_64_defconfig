## configs/hotspot_x86_64_defconfig
```kconfig
BR2_x86_64=y
BR2_x86_core_avx2=y
BR2_TOOLCHAIN_BUILDROOT_MUSL=y
BR2_KERNEL_HEADERS_5_10=y
BR2_BINUTILS_VERSION_2_45_X=y
BR2_GCC_VERSION_15_X=y
BR2_TOOLCHAIN_BUILDROOT_CXX=y
BR2_SHARED_STATIC_LIBS=y
BR2_SSP_NONE=y
BR2_PACKAGE_XZ=y
BR2_PACKAGE_ZSTD=y
BR2_PACKAGE_BINUTILS=y
BR2_PACKAGE_QT6=y
BR2_PACKAGE_QT6BASE_CONCURRENT=y
BR2_PACKAGE_QT6BASE_DBUS=y
BR2_PACKAGE_QT6BASE_XCB=y
BR2_PACKAGE_QT6BASE_DEFAULT_QPA="xcb"
BR2_PACKAGE_QT6BASE_FONTCONFIG=y
BR2_PACKAGE_QT6BASE_HARFBUZZ=y
BR2_PACKAGE_QT6BASE_GIF=y
BR2_PACKAGE_QT6BASE_JPEG=y
BR2_PACKAGE_QT6BASE_PNG=y
BR2_PACKAGE_QT6BASE_WIDGETS=y
BR2_PACKAGE_QT6BASE_PRINTSUPPORT=y
BR2_PACKAGE_QT6BASE_TEST=y
BR2_PACKAGE_QT6BASE_XML=y
BR2_PACKAGE_QT6SVG=y
BR2_PACKAGE_QT6WEBSOCKETS=y
BR2_PACKAGE_KF6=y
BR2_PACKAGE_KF6_KCOREADDONS=y
BR2_PACKAGE_KF6_THREADWEAVER=y
BR2_PACKAGE_KF6_KCONFIGWIDGETS=y
BR2_PACKAGE_KF6_KCODECS=y
BR2_PACKAGE_KF6_KCONFIG=y
BR2_PACKAGE_KF6_KGUIADDONS=y
BR2_PACKAGE_KF6_KI18N=y
BR2_PACKAGE_KF6_KWIDGETSADDONS=y
BR2_PACKAGE_KF6_KCOLORSCHEME=y
BR2_PACKAGE_KF6_KITEMVIEWS=y
BR2_PACKAGE_KF6_KITEMMODELS=y
BR2_PACKAGE_KF6_KIO=y
BR2_PACKAGE_KF6_KSERVICE=y
BR2_PACKAGE_KF6_SOLID=y
BR2_PACKAGE_KF6_KCRASH=y
BR2_PACKAGE_KF6_KWINDOWSYSTEM=y
BR2_PACKAGE_KF6_KBOOKMARKS=y
BR2_PACKAGE_KF6_KCOMPLETION=y
BR2_PACKAGE_KF6_KICONTHEMES=y
BR2_PACKAGE_KF6_KARCHIVE=y
BR2_PACKAGE_KF6_KJOBWIDGETS=y
BR2_PACKAGE_KF6_KNOTIFICATIONS=y
BR2_PACKAGE_KF6_KDBUSADDONS=y
BR2_PACKAGE_KF6_KPARTS=y
BR2_PACKAGE_KF6_KXMLGUI=y
BR2_PACKAGE_KF6_KDDOCKWIDGETS=y
BR2_PACKAGE_KF6_KGLOBALACCEL=y
BR2_PACKAGE_KF6_SYNTAX_HIGHLIGHTING=y
BR2_PACKAGE_XORG7=y
BR2_PACKAGE_XLIB_LIBFS=y
BR2_PACKAGE_XLIB_LIBXSCRNSAVER=y
BR2_PACKAGE_XLIB_LIBXAW=y
BR2_PACKAGE_XLIB_LIBXCOMPOSITE=y
BR2_PACKAGE_XLIB_LIBXCURSOR=y
BR2_PACKAGE_XLIB_LIBXDAMAGE=y
BR2_PACKAGE_XLIB_LIBXFONT=y
BR2_PACKAGE_XLIB_LIBXFONT2=y
BR2_PACKAGE_XLIB_LIBXFT=y
BR2_PACKAGE_XLIB_LIBXINERAMA=y
BR2_PACKAGE_XLIB_LIBXPRESENT=y
BR2_PACKAGE_XLIB_LIBXRES=y
BR2_PACKAGE_XLIB_LIBXTST=y
BR2_PACKAGE_XLIB_LIBXVMC=y
BR2_PACKAGE_XLIB_LIBXXF86DGA=y
BR2_PACKAGE_XLIB_LIBXXF86VM=y
BR2_PACKAGE_XLIB_LIBDMX=y
BR2_PACKAGE_XLIB_LIBXCVT=y
BR2_PACKAGE_XLIB_LIBXKBFILE=y
BR2_PACKAGE_XLIB_LIBXSHMFENCE=y
BR2_PACKAGE_LIBCANBERRA=y
BR2_PACKAGE_OPENSSL=y
BR2_PACKAGE_ELFUTILS=y
BR2_PACKAGE_ELFUTILS_LIBDEBUGINFOD=y
BR2_PACKAGE_ICU=y
BR2_PACKAGE_UTIL_LINUX=y
BR2_PACKAGE_UTIL_LINUX_LIBMOUNT=y
# BR2_TARGET_ROOTFS_TAR is not set
BR2_PACKAGE_HOST_QT6TOOLS_LINGUIST_TOOLS=y
```

## package/kf6/Config.in
```kconfig
menuconfig BR2_PACKAGE_KF6
	bool "KF6"
	depends on BR2_PACKAGE_QT6
	help
	  This option enables the KF5 KDE Frameworks. Sub-options
	  allow to select which modules should be built.

	  https://techbase.kde.org/KDE_Frameworks

if BR2_PACKAGE_KF6
source "package/kf6/kf6-extra-cmake-modules/Config.in"
source "package/kf6/kf6-kcoreaddons/Config.in"
source "package/kf6/kf6-threadweaver/Config.in"
source "package/kf6/kf6-kconfigwidgets/Config.in"
source "package/kf6/kf6-kcodecs/Config.in"
source "package/kf6/kf6-kconfig/Config.in"
source "package/kf6/kf6-kguiaddons/Config.in"
source "package/kf6/kf6-ki18n/Config.in"
source "package/kf6/kf6-kwidgetsaddons/Config.in"
source "package/kf6/kf6-kcolorscheme/Config.in"
source "package/kf6/kf6-kitemviews/Config.in"
source "package/kf6/kf6-kitemmodels/Config.in"
source "package/kf6/kf6-kio/Config.in"
source "package/kf6/kf6-kservice/Config.in"
source "package/kf6/kf6-solid/Config.in"
source "package/kf6/kf6-kcrash/Config.in"
source "package/kf6/kf6-kwindowsystem/Config.in"
source "package/kf6/kf6-kbookmarks/Config.in"
source "package/kf6/kf6-kcompletion/Config.in"
source "package/kf6/kf6-kiconthemes/Config.in"
source "package/kf6/kf6-karchive/Config.in"
source "package/kf6/kf6-kjobwidgets/Config.in"
source "package/kf6/kf6-knotifications/Config.in"
source "package/kf6/kf6-kdbusaddons/Config.in"
source "package/kf6/kf6-kparts/Config.in"
source "package/kf6/kf6-kxmlgui/Config.in"
source "package/kf6/kf6-kddockwidgets/Config.in"
source "package/kf6/kf6-kglobalaccel/Config.in"
source "package/kf6/kf6-syntax-highlighting/Config.in"
endif
```

## package/kf6/kf6-kparts/Config.in
```kconfig
config BR2_PACKAGE_KF6_KPARTS
	bool "kf6-kparts"
	select BR2_PACKAGE_KF6_EXTRA_CMAKE_MODULES
	select BR2_PACKAGE_QT6TOOLS
	help
	  KF6 is a set of Qt framework addons, extending Qt in
	  various ways, not only restricted in helping integration
	  in KDE.

	  This package contains KCoreAddons, a set of classes built
	  on top of QtCore to perform various tasks.

	  https://api.kde.org/frameworks/kcoreaddons/html/index.html
```

## package/kf6/kf6-kwindowsystem/Config.in
```kconfig
config BR2_PACKAGE_KF6_KWINDOWSYSTEM
	bool "kf6-kwindowsystem"
	select BR2_PACKAGE_KF6_EXTRA_CMAKE_MODULES
	select BR2_PACKAGE_QT6TOOLS
	help
	  KF6 is a set of Qt framework addons, extending Qt in
	  various ways, not only restricted in helping integration
	  in KDE.

	  This package contains KCoreAddons, a set of classes built
	  on top of QtCore to perform various tasks.

	  https://api.kde.org/frameworks/kcoreaddons/html/index.html
```
